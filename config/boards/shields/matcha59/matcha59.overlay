#include <dt-bindings/zmk/matrix_transform.h>

/ {
    chosen {
        zmk,kscan = &kscan0;
        zmk,matrix_transform = &matrix_transform0;
    };

    kscan0: kscan {
        compatible = "zmk,kscan-gpio-matrix";
        diode-direction = "row2col";

        /* TESTING WITH ONE ROW ONLY */
        row-gpios = <
            &gpio0 31 (GPIO_ACTIVE_HIGH | GPIO_PULL_DOWN)
        >;

        /* TESTING WITH THREE COLUMNS ONLY */
        col-gpios = <
            &gpio0 22 GPIO_ACTIVE_HIGH
            &gpio0 24 GPIO_ACTIVE_HIGH
            &gpio1 00 GPIO_ACTIVE_HIGH
        >;
    };

    matrix_transform0: matrix_transform {
        compatible = "zmk,matrix-transform";
        rows = <1>;
        columns = <3>;
        map = <
            RC(0,0) RC(0,1) RC(0,2)
        >;
    };
};
